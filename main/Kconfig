## main/Kconfig
```kconfig
# MPU6050 滤波器配置选项

menu "MPU6050 Filter Options"
    depends on MPU6050

config MPU6050_FILTER_ENABLED
    bool "Enable MPU6050 Data Filtering"
    default y
    help
      Enable sliding average filtering for MPU6050 sensor data to reduce noise.

config MPU6050_FILTER_WINDOW_SIZE
    int "Sliding Average Filter Window Size"
    range 2 20
    default 5
    depends on MPU6050_FILTER_ENABLED
    help
      Number of samples to average in the sliding window filter.
      Larger values provide more smoothing but increase latency.
      Range is 2-20, default is 5.

endmenu
```

## main/Kconfig.projbuild
```kconfig
menu "Example Configuration"

    config ESP_WIFI_SSID
        string "WiFi SSID"
        default "myssid"
        help
            SSID (network name) for the example to connect to.

    config ESP_WIFI_PASSWORD
        string "WiFi Password"
        default "mypassword"
        help
            WiFi password (WPA or WPA2) for the example to use.

    choice ESP_WIFI_SAE_MODE
        prompt "WPA3 SAE mode selection"
        default ESP_WPA3_SAE_PWE_BOTH
        help
            Select mode for SAE as Hunt and Peck, H2E or both.
        config ESP_WPA3_SAE_PWE_HUNT_AND_PECK
            bool "HUNT AND PECK"
        config ESP_WPA3_SAE_PWE_HASH_TO_ELEMENT
            bool "H2E"
        config ESP_WPA3_SAE_PWE_BOTH
            bool "BOTH"
    endchoice

    config ESP_WIFI_PW_ID
        string "PASSWORD IDENTIFIER"
        depends on  ESP_WPA3_SAE_PWE_HASH_TO_ELEMENT|| ESP_WPA3_SAE_PWE_BOTH
        default ""
        help
            password identifier for SAE H2E

    config ESP_MAXIMUM_RETRY
        int "Maximum retry"
        default 5
        help
            Set the Maximum retry to avoid station reconnecting to the AP unlimited when the AP is really inexistent.

    choice ESP_WIFI_SCAN_AUTH_MODE_THRESHOLD
        prompt "WiFi Scan auth mode threshold"
        default ESP_WIFI_AUTH_WPA2_PSK
        help
            The weakest authmode to accept in the scan mode.
            This value defaults to ESP_WIFI_AUTH_WPA2_PSK incase password is present and ESP_WIFI_AUTH_OPEN is used.
            Please select ESP_WIFI_AUTH_WEP/ESP_WIFI_AUTH_WPA_PSK incase AP is operating in WEP/WPA mode.

        config ESP_WIFI_AUTH_OPEN
            bool "OPEN"
        config ESP_WIFI_AUTH_WEP
            bool "WEP"
        config ESP_WIFI_AUTH_WPA_PSK
            bool "WPA PSK"
        config ESP_WIFI_AUTH_WPA2_PSK
            bool "WPA2 PSK"
        config ESP_WIFI_AUTH_WPA_WPA2_PSK
            bool "WPA/WPA2 PSK"
        config ESP_WIFI_AUTH_WPA3_PSK
            bool "WPA3 PSK"
        config ESP_WIFI_AUTH_WPA2_WPA3_PSK
            bool "WPA2/WPA3 PSK"
        config ESP_WIFI_AUTH_WAPI_PSK
            bool "WAPI PSK"
    endchoice

endmenu

menu "MQTT Configuration"

    config MQTT_BROKER_URI
        string "MQTT Broker URI"
        default "mqtt:/mqtt.uyuo.me"
        help
            MQTT broker URI. Can be mqtt://, mqtts://, ws://, or wss://.
            Example: mqtt://broker.emqx.io:1883

    config MQTT_USERNAME
        string "MQTT Username"
        default ""
        help
            MQTT username for authentication. Leave empty if not required.

    config MQTT_PASSWORD
        string "MQTT Password"
        default ""
        help
            MQTT password for authentication. Leave empty if not required.

    config MQTT_SUBSCRIBE_TOPIC
        string "MQTT Subscribe Topic"
        default "/topic/test/subscribe"
        help
            MQTT topic to subscribe to.

    config MQTT_PUBLISH_TOPIC
        string "MQTT Publish Topic"
        default "/topic/test/publish"
        help
            MQTT topic to publish messages to.

    config MQTT_SUBSCRIBE_TOPIC_GYRO
        string "MQTT Subscribe Topic Gyro"
        default "/device/gyro"
        help
            MQTT topic to subscribe to.

endmenu

menu "MPU6050 Configuration"

    choice EXAMPLE_I2C_ADDRESS
        prompt "Select I2C address"
        default EXAMPLE_I2C_ADDRESS_LOW
        help
            Select I2C address

        config EXAMPLE_I2C_ADDRESS_LOW
            bool "MPU6050_I2C_ADDRESS_LOW"
            help
                Choose this when ADDR pin is connected to ground
        config EXAMPLE_I2C_ADDRESS_HIGH
            bool "MPU6050_I2C_ADDRESS_HIGH"
            help
                Choose this when ADDR pin is connected to VCC
    endchoice

    config EXAMPLE_SCL_GPIO
        int "MPU6050 SCL GPIO Number"
        default 5 if IDF_TARGET_ESP8266
        default 4 if IDF_TARGET_ESP32C2 || IDF_TARGET_ESP32C3 || IDF_TARGET_ESP32C5 || IDF_TARGET_ESP32C6 || IDF_TARGET_ESP32C61
        default 4 if IDF_TARGET_ESP32H2
        default 4 if IDF_TARGET_ESP32P4
        default 9 if IDF_TARGET_ESP32 || IDF_TARGET_ESP32S2 || IDF_TARGET_ESP32S3
        help
            GPIO number for I2C Master clock line.

    config EXAMPLE_SDA_GPIO
        int "MPU6050 SDA GPIO Number"
        default 4 if IDF_TARGET_ESP8266
        default 5 if IDF_TARGET_ESP32C2 || IDF_TARGET_ESP32C3 || IDF_TARGET_ESP32C5 || IDF_TARGET_ESP32C6 || IDF_TARGET_ESP32C61
        default 5 if IDF_TARGET_ESP32H2
        default 5 if IDF_TARGET_ESP32P4
        default 8 if IDF_TARGET_ESP32 || IDF_TARGET_ESP32S2 || IDF_TARGET_ESP32S3
        help
            GPIO number for I2C Master data line.
     
endmenu
```
